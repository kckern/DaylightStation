// scantron-relay firmware — M5Stack ATOM Lite (ESP32-PICO-D4).
//
// Taps the RS-232 port of a Chatsworth Data OMR-1100 (via an M5 ATOMIC RS232
// base / MAX3232) and forwards decoded bubble-sheet reads over WebSocket to the
// DaylightStation event bus (/ws). The backend re-broadcasts the `scantron`
// topic.
//
// PROTOCOL (verified against the real unit 2026-07-21; firmware "OMR-1100 -
// Version 1.04, Wed Oct 2 1996"). Full manuals in ../../docs/recovered/.
//
//   Link:     9600 baud, 7 data bits, EVEN parity, 1 stop bit.
//   Download: 0x12 <cmd> 0x12 'E'   (Ctrl-R, command, Ctrl-R, "E" — no ESC)
//   Factory:  0x12 ESC <cmd> 0x12 'E'  (read-only queries; not used here)
//   Ack:      "G" <CR> on success, "...?" <CR> on a rejected command.
//
// THE CRITICAL DETAIL: conversion modes are VOLATILE. A reader that has just
// been powered on has NO conversion mode loaded, so it transports cards and
// emits NOTHING. The host must download a mode first — here "I00", Binary-to-
// ASCII for all columns. We re-send it periodically while the line is idle so
// the relay self-heals if the reader is power-cycled independently.
//
// Card record: two bytes per column, CR-terminated. Bit 5 (0x20) is forced high
// so every byte is printable; a blank column reads 0x20 0x20.
//
// Requires include/config.h (generated by tools/gen-config.mjs; gitignored).

#include <Arduino.h>
#include <WiFi.h>
#include <WebSocketsClient.h>
#include <ArduinoJson.h>
#include <FastLED.h>
#include "config.h"

// Onboard SK6812 status LED. GPIO27 on ATOM Lite.
#define LED_PIN   27
#define NUM_LEDS  1
static CRGB leds[NUM_LEDS];

static WebSocketsClient ws;
static bool wsConnected = false;

// Serial2 = the RS-232 tap. Native USB CDC (Serial) stays free for the monitor.
// NOTE: TX is genuinely required — the reader will not emit anything until we
// download a conversion mode to it.
#define OMR Serial2

static void setLed(const CRGB &c) { leds[0] = c; FastLED.show(); }

static void onWsEvent(WStype_t type, uint8_t *payload, size_t len) {
  switch (type) {
    case WStype_CONNECTED:
      wsConnected = true;
      setLed(CRGB::Green);
      break;
    case WStype_DISCONNECTED:
      wsConnected = false;
      setLed(CRGB::Amber);
      break;
    default:
      break;
  }
}

static void emit(JsonDocument &doc) {
  if (!wsConnected) return;
  String out;
  serializeJson(doc, out);
  ws.sendTXT(out);
}

static String toHex(const uint8_t *buf, size_t n) {
  char hex[3];
  String s;
  for (size_t i = 0; i < n; i++) { sprintf(hex, "%02X", buf[i]); s += hex; }
  return s;
}

static void emitRaw(const uint8_t *buf, size_t n) {
  JsonDocument doc;
  doc["source"] = "scantron-relay";
  doc["type"]   = "raw";
  doc["id"]     = READER_ID;
  doc["hex"]    = toHex(buf, n);
  doc["len"]    = (uint16_t)n;
  emit(doc);
}

// --- mode download -----------------------------------------------------------

// Send "I00": Binary-to-ASCII conversion for all columns (up to 126).
static void downloadMode() {
  OMR.write(0x12);
  OMR.print("I00");
  OMR.write(0x12);
  OMR.write('E');
  OMR.flush();
}

// --- record decode -----------------------------------------------------------

// Physical top-to-bottom channel order. Row 9 sits nearest the timing track.
// Each entry: which of the two bytes carries it, and the bit within that byte.
struct RowBit { const char *label; uint8_t byteIdx; uint8_t mask; };
static const RowBit ROWS[12] = {
  {"12", 0, 0x01}, {"11", 0, 0x02}, {"0", 0, 0x04},
  {"1",  0, 0x08}, {"2",  0, 0x10}, {"3", 0, 0x40},
  {"4",  1, 0x01}, {"5",  1, 0x02}, {"6", 1, 0x04},
  {"7",  1, 0x08}, {"8",  1, 0x10}, {"9", 1, 0x40},
};

// Pack one column into a 12-bit mask in the physical order above:
// bit0 = row 12 (far edge) ... bit11 = row 9 (strobe edge).
static uint16_t packColumn(uint8_t b1, uint8_t b2) {
  const uint8_t pair[2] = { b1, b2 };
  uint16_t bits = 0;
  for (uint8_t i = 0; i < 12; i++) {
    if (pair[ROWS[i].byteIdx] & ROWS[i].mask) bits |= (uint16_t)1 << i;
  }
  return bits;
}

static void handleFrame(const uint8_t *buf, size_t n) {
  // Command acknowledgements ("G", or an error echo ending in "?") share the
  // line with card data. They are never valid card records — drop them.
  if (n < 2) return;
  if (buf[n - 1] == '?') {
    JsonDocument doc;
    doc["source"] = "scantron-relay";
    doc["type"]   = "reader-error";
    doc["id"]     = READER_ID;
    doc["echo"]   = toHex(buf, n);
    emit(doc);
    return;
  }
  if (n % 2) {          // a card record is always an even number of bytes
    emitRaw(buf, n);
    return;
  }

  JsonDocument doc;
  doc["source"]  = "scantron-relay";
  doc["type"]    = "sheet";
  doc["id"]      = READER_ID;
  doc["columns"] = n / 2;

  JsonArray cols = doc["marks"].to<JsonArray>();
  uint16_t marked = 0;
  for (size_t i = 0; i + 1 < n; i += 2) {
    uint16_t bits = packColumn(buf[i], buf[i + 1]);
    cols.add(bits);
    if (bits) marked++;
  }
  doc["markedColumns"] = marked;
  emit(doc);
}

// --- plumbing ----------------------------------------------------------------

static void connectWifi() {
  setLed(CRGB::Red);
  WiFi.mode(WIFI_STA);
  WiFi.begin(WIFI_SSID, WIFI_PASSWORD);
  while (WiFi.status() != WL_CONNECTED) { delay(250); }
  setLed(CRGB::Blue);
}

void setup() {
  Serial.begin(115200);
  FastLED.addLeds<SK6812, LED_PIN, GRB>(leds, NUM_LEDS);
  FastLED.setBrightness(40);

  OMR.begin(UART_BAUD, UART_CONFIG, UART_RX_PIN, UART_TX_PIN);

  connectWifi();

  ws.begin(BACKEND_HOST, BACKEND_PORT, WS_PATH);
  ws.onEvent(onWsEvent);
  ws.setReconnectInterval(3000);

  delay(200);
  downloadMode();
}

// Records are CR-terminated, so CR is the frame boundary. The idle timeout is
// only a backstop for a truncated record.
static const uint32_t FRAME_IDLE_MS   = 250;
static const uint32_t REARM_PERIOD_MS = 60000;  // re-download mode when idle
static const uint32_t REARM_QUIET_MS  = 5000;   // ...but never mid-scan

static uint8_t  frameBuf[512];
static size_t   frameLen   = 0;
static uint32_t lastByteMs = 0;
static uint32_t lastArmMs  = 0;

static void flushFrame() {
  if (!frameLen) return;
#if SNIFF_MODE
  emitRaw(frameBuf, frameLen);
#else
  handleFrame(frameBuf, frameLen);
#endif
  frameLen = 0;
  setLed(wsConnected ? CRGB::Green : CRGB::Amber);
}

void loop() {
  ws.loop();

  while (OMR.available()) {
    int b = OMR.read();
    if (b < 0) break;
    lastByteMs = millis();
    setLed(CRGB::Purple);              // bytes flowing
    if (b == 0x0D) { flushFrame(); continue; }
    if (frameLen < sizeof(frameBuf)) frameBuf[frameLen++] = (uint8_t)b;
  }

  if (frameLen > 0 && (millis() - lastByteMs) > FRAME_IDLE_MS) flushFrame();

  // Self-heal: if the reader is power-cycled it silently forgets its
  // conversion mode. Re-arming costs one "G" ack and is safe while idle.
  uint32_t now = millis();
  if (now - lastArmMs > REARM_PERIOD_MS && now - lastByteMs > REARM_QUIET_MS) {
    lastArmMs = now;
    downloadMode();
  }
}
