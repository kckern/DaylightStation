// omr-relay firmware — M5Stack ATOM Lite (ESP32-PICO-D4).
//
// Taps the RS-232 port of a Chatsworth Data OMR-1100 (via an M5 ATOMIC RS232
// base / MAX3232) and forwards decoded bubble-sheet reads over WebSocket to the
// DaylightStation event bus (/ws). The backend re-broadcasts the `omr`
// topic.
//
// PROTOCOL (verified against the real unit 2026-07-21; firmware "OMR-1100 -
// Version 1.04, Wed Oct 2 1996"). Full manuals in ../../docs/recovered/.
//
//   Link:     9600 baud, 7 data bits, EVEN parity, 1 stop bit.
//   Download: 0x12 <cmd> 0x12 'E'   (Ctrl-R, command, Ctrl-R, "E" — no ESC)
//   Factory:  0x12 ESC <cmd> 0x12 'E'  (read-only queries; not used here)
//   Ack:      "G" <CR> on success, "...?" <CR> on a rejected command.
//
// THE CRITICAL DETAIL: conversion modes are VOLATILE. A reader that has just
// been powered on has NO conversion mode loaded, so it transports cards and
// emits NOTHING. The host must download a mode first — here "I00", Binary-to-
// ASCII for all columns. We re-send it periodically while the line is idle so
// the relay self-heals if the reader is power-cycled independently.
//
// Card record: two bytes per column, CR-terminated. Bit 5 (0x20) is forced high
// so every byte is printable; a blank column reads 0x20 0x20.
//
// Requires include/config.h (generated by tools/gen-config.mjs; gitignored).

#include <Arduino.h>
#include <WiFi.h>
#include <WebServer.h>
#include <WebSocketsClient.h>
#include <ArduinoJson.h>
#include <FastLED.h>
#include "config.h"

// A config.h generated before the NFC/buzzer keys existed simply has none of
// these. The ack machinery is compiled unconditionally (it costs nothing when
// nothing registers), so it needs a default rather than a missing-macro error.
#ifndef BUZZER_ACK_TIMEOUT_MS
#define BUZZER_ACK_TIMEOUT_MS 2000
#endif

#if NFC_ENABLED
// ============================ NFC tap reader =================================
// M5 Unit NFC (SKU U216) on the ATOM's Grove port — an ST25R3916 NFC front-end
// over I2C. A student taps a card to start a session; the relay emits an `nfc`
// message over the same bus link the sheets use.
//
// Verified on hardware 2026-07-29: the chip answers at I2C 0x50 with IC Identity
// 0x2A (ic_type 5, silicon rev 2), and an NTAG 215 read as uid 04669C0FCB2A81.
//
// WHY THIS RUNS ON ITS OWN CORE: a FAILED detect() blocks for its entire timeout.
// The UART reader in loop() is the only hard real-time path in this firmware — at
// 9600 baud a byte lands every ~1 ms and the RX ring is finite — so NFC polling
// must never sit in front of it. The ESP32-PICO-D4 has two cores and the Arduino
// loop() runs on core 1, so the poll is pinned to core 0 and hands results across
// a FreeRTOS queue. The OMR path is otherwise untouched, and the outbound bus
// queue stays single-threaded because only core 1 ever calls emit().
#include <Wire.h>
#include <M5Unified.h>
#include <M5UnitUnified.h>
#include <M5UnitUnifiedNFC.h>

struct NfcCard {
  char     uid[32];
  char     type[32];
  uint16_t atqa;
  uint8_t  sak;
  uint32_t atMs;   // millis() at read, so the bus message dates the TAP
};

// Depth 8: a tap produces one entry and core 1 drains every loop, so this only
// ever fills if core 1 is wedged — in which case counting the loss is the point.
static const size_t NFC_HANDOFF_DEPTH = 8;
static QueueHandle_t nfcQueue   = nullptr;
static uint32_t cNfcCards       = 0;   // cards handed to the bus
static uint32_t cNfcPolls       = 0;   // detect attempts
static uint32_t cNfcHandoffLost = 0;   // handoff queue was full
static uint32_t lastNfcMs       = 0;
static volatile bool nfcReady   = false;
#endif  // NFC_ENABLED

#if BUZZER_ENABLED
// ============================ audible tap ACK ================================
// Active (self-oscillating) buzzer wired GND + a free pad on the ATOMIC RS232
// base (its silkscreen leaves only GPIO23 and GPIO33 free), gated through LEDC.
//
// A status LED cannot serve as the ACK: this board lives in a case where nobody
// can see it. The tap has to make a sound.
//
// DO NOT try to quieten this by lowering duty. Measured on hardware 2026-07-29:
// at duty 5 / 15 / 40 / 80 the buzzer SCRATCHED rather than playing a quieter
// tone, and only 160+ produced a clean note. An active buzzer has its own
// oscillator with a minimum working voltage, and a chopped supply below that
// starves it — so duty is a DISTORTION control here, not a volume control.
// Loudness is set by DURATION at full duty: a 4 ms pulse never lets the
// diaphragm reach full amplitude, which reads as a soft tick. To go quieter than
// duration allows, add a series resistor (~100-470R) or damp it in the case.
//
// Non-blocking by construction: started and expired from loop(), never delay().
// A delay here would stall the UART drain, which is the entire reason the NFC
// poll was moved to the other core.
// PITCH: only a PASSIVE element (piezo transducer) has controllable pitch. An
// active buzzer plays its own fixed tone, so `tone` is ignored and meaning comes
// from RHYTHM. Both live behind one pattern table, so swapping the hardware is a
// config change (buzzer.kind) rather than a firmware change.
struct BuzzStep {
  uint16_t tone;   // Hz; passive only. 0 = use the plain gated drive
  uint16_t ms;     // sound for this long
  uint16_t gap;    // then stay silent this long
};

static const int BUZZER_LEDC_CHANNEL = 0;   // nothing else here uses LEDC

static const BuzzStep SND_READ[SND_READ_LEN]           = SND_READ_INIT;
static const BuzzStep SND_CONFIRMED[SND_CONFIRMED_LEN] = SND_CONFIRMED_INIT;
static const BuzzStep SND_FAILED[SND_FAILED_LEN]       = SND_FAILED_INIT;

// Non-blocking sequencer. Everything is advanced from loop(); nothing here may
// delay(), because a delay would stall the UART drain.
static const BuzzStep *seqSteps = nullptr;
static uint8_t  seqLen   = 0;
static uint8_t  seqIdx   = 0;
static bool     seqOn    = false;   // currently sounding (vs in the gap)
static uint32_t seqNextMs = 0;
static uint32_t cBeeps   = 0;       // patterns played

static void toneOn(uint16_t tone) {
#if BUZZER_PASSIVE
  if (tone > 0) { ledcWriteTone(BUZZER_LEDC_CHANNEL, tone); return; }
#else
  (void)tone;
#endif
  ledcWrite(BUZZER_LEDC_CHANNEL, BUZZER_DUTY);
}

static void toneOff() { ledcWrite(BUZZER_LEDC_CHANNEL, 0); }

static void buzzerInit() {
  ledcSetup(BUZZER_LEDC_CHANNEL, BUZZER_FREQ_HZ, 8);
  ledcAttachPin(BUZZER_PIN, BUZZER_LEDC_CHANNEL);
  toneOff();
}

// A new pattern preempts whatever is playing: the newest event is the one the
// person in the room cares about, and queueing patterns would let a backlog of
// beeps outlive the thing that caused them.
static void buzzerPlay(const BuzzStep *steps, uint8_t len) {
  if (!steps || !len) return;
  seqSteps = steps;
  seqLen   = len;
  seqIdx   = 0;
  seqOn    = true;
  seqNextMs = millis() + steps[0].ms;
  toneOn(steps[0].tone);
  cBeeps++;
}

static void buzzerService() {
  if (!seqSteps) return;
  if ((int32_t)(millis() - seqNextMs) < 0) return;   // rollover-safe

  if (seqOn) {
    toneOff();
    seqOn = false;
    if (seqSteps[seqIdx].gap) { seqNextMs = millis() + seqSteps[seqIdx].gap; return; }
  }
  if (++seqIdx >= seqLen) { seqSteps = nullptr; seqLen = 0; return; }
  seqOn = true;
  seqNextMs = millis() + seqSteps[seqIdx].ms;
  toneOn(seqSteps[seqIdx].tone);
}
#endif  // BUZZER_ENABLED

// ============================ round-trip ACK =================================
// A local beep only proves the CARD was read — it says nothing about whether the
// server got it. So the relay subscribes to its own bus topic and waits for the
// backend to echo the event back, which is a real round trip: received,
// validated, re-broadcast. Echo => `confirmed` sound. Silence => `failed`.
//
// Deliberately NOT a disk-level guarantee: the backend broadcasts first and
// persists on the subscriber chain immediately after, so this confirms ACCEPTANCE.
// A storage ack would need a new backend message.
//
// No new backend capability is needed for this — `client-control:<clientId>`
// exists but "logs a warn and drops" because connection identity isn't tracked,
// whereas topic subscription already works.
struct PendingAck {
  bool     used;
  char     kind[8];   // "nfc" | "sheet"
  char     key[24];   // nfc: uid. sheet: empty, matched oldest-first
  uint32_t dueMs;
};
static const size_t PENDING_MAX = 4;
static PendingAck pending[PENDING_MAX];
static uint32_t cAckOk = 0, cAckTimeout = 0;

// ============================ event log ======================================
// A short rolling window of what happened, readable from the LAN at any time.
// Distinct from /recent (raw UART frames): this is the lifecycle — read, ack,
// timeout — which is what you actually want when someone says "I tapped it and
// nothing happened".
struct LogEntry { uint32_t atMs; char kind[12]; char detail[72]; };
static const size_t LOG_MAX = 32;
static LogEntry logBuf[LOG_MAX];
static size_t logCount = 0, logNext = 0;

static void logEvent(const char *kind, const char *fmt, ...) {
  LogEntry &e = logBuf[logNext];
  e.atMs = millis();
  snprintf(e.kind, sizeof(e.kind), "%s", kind);
  va_list ap;
  va_start(ap, fmt);
  vsnprintf(e.detail, sizeof(e.detail), fmt, ap);
  va_end(ap);
  logNext = (logNext + 1) % LOG_MAX;
  if (logCount < LOG_MAX) logCount++;
}

// Register an outstanding message. If the slots are full the OLDEST is dropped:
// the sound is feedback for a person standing there, and a stale unacked message
// from a minute ago is worth less than the one they just triggered.
static void ackExpect(const char *kind, const char *key) {
  PendingAck *slot = nullptr;
  for (size_t i = 0; i < PENDING_MAX; i++) if (!pending[i].used) { slot = &pending[i]; break; }
  if (!slot) {
    size_t oldest = 0;
    for (size_t i = 1; i < PENDING_MAX; i++) {
      if ((int32_t)(pending[i].dueMs - pending[oldest].dueMs) < 0) oldest = i;
    }
    slot = &pending[oldest];
    logEvent("ack-evict", "slots full, dropped a pending %s", slot->kind);
  }
  slot->used = true;
  snprintf(slot->kind, sizeof(slot->kind), "%s", kind);
  snprintf(slot->key, sizeof(slot->key), "%s", key ? key : "");
  slot->dueMs = millis() + BUZZER_ACK_TIMEOUT_MS;
}

// Match an echo from the bus. For `nfc` the uid disambiguates; sheets carry no
// natural key, so the oldest outstanding sheet is matched.
static void ackResolve(const char *kind, const char *key) {
  PendingAck *best = nullptr;
  for (size_t i = 0; i < PENDING_MAX; i++) {
    if (!pending[i].used || strcmp(pending[i].kind, kind) != 0) continue;
    if (key && key[0] && pending[i].key[0] && strcmp(pending[i].key, key) != 0) continue;
    if (!best || (int32_t)(pending[i].dueMs - best->dueMs) < 0) best = &pending[i];
  }
  if (!best) return;   // an echo we weren't waiting for: ignore, never beep
  best->used = false;
  cAckOk++;
  logEvent("ack-ok", "%s %s confirmed by server", kind, key && key[0] ? key : "");
#if BUZZER_ENABLED
  buzzerPlay(SND_CONFIRMED, SND_CONFIRMED_LEN);
#endif
}

static void ackService() {
  for (size_t i = 0; i < PENDING_MAX; i++) {
    if (!pending[i].used) continue;
    if ((int32_t)(millis() - pending[i].dueMs) < 0) continue;
    pending[i].used = false;
    cAckTimeout++;
    logEvent("ack-timeout", "%s %s got no server echo", pending[i].kind, pending[i].key);
#if BUZZER_ENABLED
    buzzerPlay(SND_FAILED, SND_FAILED_LEN);
#endif
  }
}

// Onboard SK6812 status LED. GPIO27 on ATOM Lite.
#define LED_PIN   27
#define NUM_LEDS  1
static CRGB leds[NUM_LEDS];

// LED POLICY: dark by default. The only thing that lights this LED is data
// arriving from the reader — a brief flash per byte burst, then off again.
// Connectivity state deliberately does NOT drive it; that lives on /health,
// where it can be read without standing in the room.
static const CRGB FLASH_COLOR = CRGB::Purple;
static const uint32_t LED_FLASH_MS = 120;
static uint32_t ledOffAtMs = 0;

static WebSocketsClient ws;
static bool wsConnected = false;

// Read-only diagnostics server. Deliberately has no mutating routes: this board
// sits on the LAN unauthenticated, and nothing here should be able to change
// reader state or clear the queue.
static WebServer http(80);

// Serial2 = the RS-232 tap. Native USB CDC (Serial) stays free for the monitor.
// NOTE: TX is genuinely required — the reader will not emit anything until we
// download a conversion mode to it.
#define OMR Serial2

// Only push to the LED when the color actually changes. setLed() is called once
// per received BYTE in loop(), and FastLED.show() is not free — on ESP32 it
// drives the RMT peripheral and blocks for the ~300 us reset latch. At 9600 baud
// a byte lands every ~1 ms, so an unconditional show() would spend a third of the
// inter-byte window in the LED driver for no visible benefit.
static CRGB ledCurrent = CRGB::Black;
static void setLed(const CRGB &c) {
  if (c.r == ledCurrent.r && c.g == ledCurrent.g && c.b == ledCurrent.b) return;
  ledCurrent = c;
  leds[0] = c;
  FastLED.show();
}

// ============================ counters =======================================
// Every discard path increments something here, and everything here is exposed
// over HTTP. "It just didn't show up" must always be answerable.
static uint32_t cBytesRx      = 0;   // bytes read off the UART
static uint32_t cFrames       = 0;   // CR-terminated frames seen
static uint32_t cSheets       = 0;   // frames decoded as cards
static uint32_t cReaderErrors = 0;   // "...?" rejection echoes
static uint32_t cRawFrames    = 0;   // odd-length / sniff-mode frames
static uint32_t cTruncated    = 0;   // frames that overran frameBuf
static uint32_t cShortFrames  = 0;   // n<2, i.e. the "G" ack and stray noise
static uint32_t cRearms       = 0;   // mode downloads sent
static uint32_t cWsConnects   = 0;
static uint32_t lastFrameMs   = 0;   // millis() of the last completed frame

// ============================ outbound queue =================================
// The bus link is NOT assumed up. A card fed while WiFi or the backend is down
// must survive until the link returns: a bubble sheet is a one-shot physical
// event, and you cannot ask a student to re-feed a sheet you silently lost.
//
// This replaces `emit()`'s old first line, `if (!wsConnected) return;`, which
// discarded every message during an outage with no counter, no log, and no
// change to the status LED. Nothing upstream could tell the difference between
// "no cards were fed" and "every card was thrown away".
//
// Bounded on BOTH item count and total bytes — a 126-column sheet is ~700 bytes
// of JSON, and an unbounded queue would exhaust the heap during a long outage,
// turning a recoverable outage into a crash loop. On overflow the OLDEST entry
// is evicted and `qDropped` increments. Eviction is always counted, always
// visible in /health and /queue, and pushed to the backend in a `relay-status`
// message on reconnect. Nothing is ever dropped quietly.
struct QueuedMsg {
  String   json;   // complete JSON object; `ageMs` is appended at send time
  uint32_t atMs;   // millis() at capture
};

static const size_t QUEUE_MAX_ITEMS = 64;
static const size_t QUEUE_MAX_BYTES = 40960;  // ~40 KB against ~280 KB free heap

static QueuedMsg qBuf[QUEUE_MAX_ITEMS];
static size_t   qHead      = 0;   // index of the oldest entry
static size_t   qCount     = 0;
static size_t   qBytes     = 0;
static uint32_t qDropped   = 0;   // evicted without ever being delivered
static uint32_t qDelivered = 0;
static uint32_t qMaxDepth  = 0;   // high-water mark, for sizing the bound later

static void queuePopOldest(bool countAsDrop) {
  if (!qCount) return;
  qBytes -= qBuf[qHead].json.length();
  qBuf[qHead].json = String();     // release the heap block now, not at overwrite
  qHead = (qHead + 1) % QUEUE_MAX_ITEMS;
  qCount--;
  if (countAsDrop) qDropped++;
}

static void queuePush(const String &json) {
  while (qCount >= QUEUE_MAX_ITEMS ||
         (qCount > 0 && qBytes + json.length() > QUEUE_MAX_BYTES)) {
    queuePopOldest(true);
  }
  const size_t tail = (qHead + qCount) % QUEUE_MAX_ITEMS;
  qBuf[tail].json = json;
  qBuf[tail].atMs = millis();
  qBytes += json.length();
  qCount++;
  if (qCount > qMaxDepth) qMaxDepth = qCount;
}

// Queue unconditionally. The drain decides when it actually goes out, so the
// capture path never depends on link state.
static void emit(JsonDocument &doc) {
  String out;
  serializeJson(doc, out);
  queuePush(out);
}

// Bounded per-loop drain: a long backlog must not starve the UART reader, which
// is the one thing in this firmware with a hard real-time constraint.
static const size_t DRAIN_PER_LOOP = 4;

static void drainQueue() {
  if (!wsConnected) return;
  for (size_t i = 0; i < DRAIN_PER_LOOP && qCount; i++) {
    QueuedMsg &m = qBuf[qHead];
    // Stamp delivery lag so the backend can reconstruct WHEN THE CARD WAS READ
    // rather than when the socket happened to come back. Without this a sheet
    // queued across a 10-minute outage is recorded at delivery time, and one
    // queued across midnight lands in the wrong day file entirely.
    String out = m.json;
    if (out.endsWith("}")) {
      out.remove(out.length() - 1);
      out += ",\"ageMs\":";
      out += String((uint32_t)(millis() - m.atMs));
      out += "}";
    }
    if (!ws.sendTXT(out)) break;   // link died mid-drain — keep the item queued
    queuePopOldest(false);
    qDelivered++;
  }
}

static String toHex(const uint8_t *buf, size_t n) {
  char hex[3];
  String s;
  for (size_t i = 0; i < n; i++) { sprintf(hex, "%02X", buf[i]); s += hex; }
  return s;
}

// ---- recent-frame ring (live diagnostics; RAM only, lost on reboot) ---------
// Distinct from the outbound queue: this records what the UART SAW, whether or
// not it was delivered. It is what makes the loopback bring-up test answerable
// over the network instead of requiring a USB cable and a serial monitor.
struct RecentFrame {
  uint32_t atMs;
  uint16_t len;
  bool     truncated;
  String   kind;
  String   hex;      // truncated preview
};
static const size_t RECENT_MAX      = 16;
static const size_t RECENT_HEX_CHARS = 64;
static RecentFrame recentBuf[RECENT_MAX];
static size_t recentHead = 0, recentCount = 0;

static void recentPush(const char *kind, const uint8_t *buf, size_t n, bool truncated) {
  const size_t slot = (recentHead + recentCount) % RECENT_MAX;
  if (recentCount == RECENT_MAX) { recentHead = (recentHead + 1) % RECENT_MAX; }
  else { recentCount++; }
  RecentFrame &f = recentBuf[slot];
  f.atMs = millis();
  f.len = (uint16_t)n;
  f.truncated = truncated;
  f.kind = kind;
  String hex = toHex(buf, n);
  f.hex = hex.length() > RECENT_HEX_CHARS ? hex.substring(0, RECENT_HEX_CHARS) + "..." : hex;
}

static void emitRaw(const uint8_t *buf, size_t n, bool truncated = false) {
  cRawFrames++;
  JsonDocument doc;
  doc["source"] = "omr-relay";
  doc["type"]   = "raw";
  doc["id"]     = READER_ID;
  doc["hex"]    = toHex(buf, n);
  doc["len"]    = (uint16_t)n;
  if (truncated) doc["truncated"] = true;
  emit(doc);
}

// Declared after the queue because the CONNECTED case reports queue depth and
// losses the moment the link returns — an outage should show up in the backend
// log, not only to whoever thinks to poll this board.
static void onWsEvent(WStype_t type, uint8_t *payload, size_t len) {
  switch (type) {
    case WStype_CONNECTED: {
      wsConnected = true;
      cWsConnects++;
      JsonDocument doc;
      doc["source"]    = "omr-relay";
      doc["type"]      = "relay-status";
      doc["id"]        = READER_ID;
      doc["queued"]    = qCount;
      doc["dropped"]   = qDropped;
      doc["truncated"] = cTruncated;
      doc["uptimeMs"]  = millis();
      emit(doc);

      // Subscribe to our own topic so the backend's re-broadcast comes BACK to
      // us — that echo is the round-trip ack. Sent directly rather than through
      // emit(): it is a control frame, and it has to be in place before the next
      // event's echo can arrive.
      {
        String sub = String("{\"type\":\"bus_command\",\"action\":\"subscribe\",\"topic\":\"")
                   + BUS_TOPIC + "\"}";
        ws.sendTXT(sub);
      }
      logEvent("ws", "connected, subscribed to %s", BUS_TOPIC);
      break;
    }
    case WStype_DISCONNECTED:
      wsConnected = false;
      logEvent("ws", "disconnected");
      break;

    // The echo of our own event, coming back off the bus after the backend
    // accepted it. Anything else on this topic is ignored.
    case WStype_TEXT: {
      JsonDocument in;
      if (deserializeJson(in, payload, len)) return;   // not JSON: ignore quietly
      const char *ev = in["event"] | "";
      const char *id = in["id"] | "";
      // Another reader's traffic on a shared topic must never beep this box.
      if (strcmp(id, READER_ID) != 0) return;
      if (strcmp(ev, "nfc") == 0) {
        const char *uid = in["uid"] | "";
        ackResolve("nfc", uid);
      } else if (strcmp(ev, "sheet") == 0) {
        ackResolve("sheet", "");
      }
      break;
    }
    default:
      break;
  }
}

#if NFC_ENABLED
// --- NFC poll (core 0) -------------------------------------------------------
// This task owns the I2C bus and the ST25R3916 exclusively. The ONLY thing it
// shares with core 1 is nfcQueue, so nothing here touches the outbound bus queue,
// the counters core 1 serves over HTTP, or the buzzer.
static void nfcTask(void *) {
  Wire.begin(NFC_SDA_PIN, NFC_SCL_PIN, NFC_I2C_HZ);

  static m5::unit::UnitUnified units;
  static m5::unit::UnitNFC     unit;
  static m5::nfc::NFCLayerA    nfcA{unit};

  // The technology must be chosen BEFORE begin(): the chip holds one at a time,
  // and every transmit in the wrong mode fails with "Illegal mode".
  auto cfg = unit.config();
  cfg.mode = m5::nfc::NFC::A;
  unit.config(cfg);

  if (!units.add(unit, Wire) || !units.begin()) {
    // Deliberately not fatal. A missing or dead NFC unit must not take the OMR
    // relay down with it — sheets are the primary job. /health reports nfc.ready
    // false so this is visible from the LAN rather than only on the serial log.
    Serial.println("[nfc] init FAILED — NFC inactive for this boot");
    vTaskDelete(nullptr);
    return;
  }
  nfcReady = true;
  Serial.println("[nfc] ready");

  for (;;) {
    units.update();
    cNfcPolls++;

    std::vector<m5::nfc::a::PICC> piccs;
    if (nfcA.detect(piccs, NFC_DETECT_TIMEOUT_MS)) {
      for (auto &&p : piccs) {
        nfcA.identify(p);   // detect() only provisionally classifies from sak
        NfcCard card{};
        snprintf(card.uid,  sizeof(card.uid),  "%s", p.uidAsString().c_str());
        snprintf(card.type, sizeof(card.type), "%s", p.typeAsString().c_str());
        card.atqa = p.atqa;
        card.sak  = p.sak;
        card.atMs = millis();
        // Zero wait: the ACK and the bus message belong to core 1, and a full
        // handoff must not stall the reader. Loss is counted, never silent.
        if (xQueueSend(nfcQueue, &card, 0) != pdTRUE) cNfcHandoffLost++;
      }
      // HLTA the card so it stops answering while it rests on the antenna. A
      // halted PICC ignores REQA until it leaves the field and loses power —
      // which is exactly the debounce a tap wants: one tap, one trigger, and a
      // card left lying on the reader does not re-fire forever.
      nfcA.deactivate();
    }
    vTaskDelay(pdMS_TO_TICKS(NFC_POLL_MS));
  }
}

// Runs on core 1 from loop(), which is what keeps emit()/the outbound queue and
// the buzzer single-threaded.
static void drainNfcQueue() {
  if (!nfcQueue) return;
  NfcCard card;
  while (xQueueReceive(nfcQueue, &card, 0) == pdTRUE) {
    cNfcCards++;
    lastNfcMs = card.atMs;
    logEvent("nfc", "read %s (%s)", card.uid, card.type);
#if BUZZER_ENABLED
    buzzerPlay(SND_READ, SND_READ_LEN);   // "I read your card"
#endif
    // ...and start waiting for the server to say it got it. The `confirmed` or
    // `failed` sound follows from the echo, not from this local read.
    ackExpect("nfc", card.uid);

    JsonDocument doc;
    doc["source"]   = "omr-relay";
    doc["type"]     = "nfc";
    doc["id"]       = READER_ID;
    doc["uid"]      = card.uid;
    doc["piccType"] = card.type;
    doc["atqa"]     = card.atqa;
    doc["sak"]      = card.sak;
    emit(doc);
  }
}
#endif  // NFC_ENABLED

// --- mode download -----------------------------------------------------------

// Send "I00": Binary-to-ASCII conversion for all columns (up to 126).
static void downloadMode() {
  OMR.write(0x12);
  OMR.print("I00");
  OMR.write(0x12);
  OMR.write('E');
  OMR.flush();
  cRearms++;
}

// ============================ HTTP diagnostics ===============================

static const char *framingName() {
#if   UART_CONFIG == SERIAL_7E1
  return "7E1";
#elif UART_CONFIG == SERIAL_8N1
  return "8N1";
#else
  return "other";
#endif
}

static void fillStatus(JsonDocument &doc) {
  doc["id"]        = READER_ID;
  doc["source"]    = "omr-relay";
  doc["topic"]     = BUS_TOPIC;
  doc["uptimeMs"]  = millis();
  doc["freeHeap"]  = ESP.getFreeHeap();

  JsonObject net = doc["net"].to<JsonObject>();
  net["ip"]       = WiFi.localIP().toString();
  net["rssi"]     = WiFi.RSSI();
  net["connected"] = WiFi.status() == WL_CONNECTED;

  JsonObject bus = doc["bus"].to<JsonObject>();
  bus["host"]      = BACKEND_HOST;
  bus["port"]      = BACKEND_PORT;
  bus["path"]      = WS_PATH;
  bus["connected"] = wsConnected;
  bus["connects"]  = cWsConnects;

  // The compiled UART config, so "which pins did we actually flash?" is
  // answerable from the LAN instead of by reading config.h on the build host.
  JsonObject uart = doc["uart"].to<JsonObject>();
  uart["baud"]      = UART_BAUD;
  uart["framing"]   = framingName();
  uart["rxPin"]     = UART_RX_PIN;
  uart["txPin"]     = UART_TX_PIN;
  uart["sniffMode"] = (bool)SNIFF_MODE;

  JsonObject c = doc["counters"].to<JsonObject>();
  c["bytesRx"]      = cBytesRx;
  c["frames"]       = cFrames;
  c["sheets"]       = cSheets;
  c["readerErrors"] = cReaderErrors;
  c["rawFrames"]    = cRawFrames;
  c["truncated"]    = cTruncated;
  c["shortFrames"]  = cShortFrames;
  c["rearms"]       = cRearms;
  // null, not -1: the ternary would unify both arms as uint32_t and serialize
  // "never seen a frame" as 4294967295, which reads like a real elapsed time.
  if (lastFrameMs) c["lastFrameMsAgo"] = millis() - lastFrameMs;
  else             c["lastFrameMsAgo"] = nullptr;

  JsonObject q = doc["queue"].to<JsonObject>();
  q["length"]    = qCount;
  q["bytes"]     = qBytes;
  q["maxItems"]  = QUEUE_MAX_ITEMS;
  q["maxBytes"]  = QUEUE_MAX_BYTES;
  q["maxDepth"]  = qMaxDepth;
  q["delivered"] = qDelivered;
  q["dropped"]   = qDropped;      // non-zero here means data was LOST
  doc["ok"] = (qDropped == 0 && cTruncated == 0)
#if NFC_ENABLED
              && (cNfcHandoffLost == 0)
#endif
              ;

#if NFC_ENABLED
  // Compiled NFC config plus liveness, so "is the tap reader working?" is
  // answerable from the LAN without opening the case.
  JsonObject n = doc["nfc"].to<JsonObject>();
  n["enabled"]          = true;
  n["ready"]            = nfcReady;   // false => the unit failed to initialise
  n["sdaPin"]           = NFC_SDA_PIN;
  n["sclPin"]           = NFC_SCL_PIN;
  n["i2cHz"]            = NFC_I2C_HZ;
  n["pollMs"]           = NFC_POLL_MS;
  n["detectTimeoutMs"]  = NFC_DETECT_TIMEOUT_MS;
  n["polls"]            = cNfcPolls;
  n["cards"]            = cNfcCards;
  n["handoffLost"]      = cNfcHandoffLost;   // non-zero means a TAP was lost
  if (lastNfcMs) n["lastCardMsAgo"] = millis() - lastNfcMs;
  else           n["lastCardMsAgo"] = nullptr;   // null, not a bogus elapsed time
#else
  doc["nfc"]["enabled"] = false;
#endif

  // Round-trip ack: ackTimeout > 0 means a read never reached the server.
  JsonObject ak = doc["ack"].to<JsonObject>();
  ak["timeoutMs"] = BUZZER_ACK_TIMEOUT_MS;
  ak["ok"]        = cAckOk;
  ak["timedOut"]  = cAckTimeout;
  { size_t p = 0; for (size_t i = 0; i < PENDING_MAX; i++) if (pending[i].used) p++;
    ak["pending"] = p; }

#if BUZZER_ENABLED
  JsonObject bz = doc["buzzer"].to<JsonObject>();
  bz["enabled"] = true;
  bz["pin"]     = BUZZER_PIN;
  bz["passive"] = (bool)BUZZER_PASSIVE;   // false => `tone` is ignored, rhythm only
  bz["duty"]    = BUZZER_DUTY;
  bz["freqHz"]  = BUZZER_FREQ_HZ;
  bz["beeps"]   = cBeeps;   // patterns played, not individual pulses
  // The compiled vocabulary, so "which sounds does this board actually know?"
  // is answerable without reading config.h on the build host.
  JsonObject sn = bz["sounds"].to<JsonObject>();
  sn["readSteps"]      = SND_READ_LEN;
  sn["confirmedSteps"] = SND_CONFIRMED_LEN;
  sn["failedSteps"]    = SND_FAILED_LEN;
#else
  doc["buzzer"]["enabled"] = false;
#endif
}

static void sendJson(JsonDocument &doc) {
  String out;
  serializeJson(doc, out);
  http.send(200, "application/json", out);
}

static void handleStatus() {
  JsonDocument doc;
  fillStatus(doc);
  sendJson(doc);
}

// A short rolling window of the LIFECYCLE — read, ack, timeout, ws state — so
// "I tapped it and nothing happened" is answerable from the LAN at any time,
// without a serial cable and without having been watching when it happened.
// Newest first. Distinct from /recent, which is raw UART frames.
static void handleEvents() {
  JsonDocument doc;
  doc["count"]      = logCount;
  doc["capacity"]   = LOG_MAX;
  doc["uptimeMs"]   = millis();
  doc["ackOk"]      = cAckOk;
  doc["ackTimeout"] = cAckTimeout;
  JsonArray arr = doc["events"].to<JsonArray>();
  // Walk backwards from the most recent write so the newest entry is first.
  for (size_t i = 0; i < logCount; i++) {
    const LogEntry &e = logBuf[(logNext + LOG_MAX - 1 - i) % LOG_MAX];
    JsonObject o = arr.add<JsonObject>();
    o["msAgo"]  = millis() - e.atMs;
    o["kind"]   = e.kind;
    o["detail"] = e.detail;
  }
  sendJson(doc);
}

// Full queue contents, not just the depth. The payloads are small and this is
// exactly what you want when the bus has been down and you need to know whether
// a specific card is safely held.
static void handleQueue() {
  JsonDocument doc;
  doc["length"]    = qCount;
  doc["bytes"]     = qBytes;
  doc["delivered"] = qDelivered;
  doc["dropped"]   = qDropped;
  doc["maxDepth"]  = qMaxDepth;
  JsonArray items = doc["items"].to<JsonArray>();
  for (size_t i = 0; i < qCount; i++) {
    const QueuedMsg &m = qBuf[(qHead + i) % QUEUE_MAX_ITEMS];
    JsonObject o = items.add<JsonObject>();
    o["ageMs"]   = millis() - m.atMs;
    o["bytes"]   = m.json.length();
    o["payload"] = m.json;     // verbatim, so you can see the actual marks[]
  }
  sendJson(doc);
}

// What the UART actually saw, delivered or not.
static void handleRecent() {
  JsonDocument doc;
  doc["count"] = recentCount;
  JsonArray items = doc["frames"].to<JsonArray>();
  for (size_t i = 0; i < recentCount; i++) {
    const RecentFrame &f = recentBuf[(recentHead + i) % RECENT_MAX];
    JsonObject o = items.add<JsonObject>();
    o["ageMs"]     = millis() - f.atMs;
    o["kind"]      = f.kind;
    o["len"]       = f.len;
    o["truncated"] = f.truncated;
    o["hex"]       = f.hex;
  }
  sendJson(doc);
}

// --- record decode -----------------------------------------------------------

// Physical top-to-bottom channel order. Row 9 sits nearest the timing track.
// Each entry: which of the two bytes carries it, and the bit within that byte.
struct RowBit { const char *label; uint8_t byteIdx; uint8_t mask; };
static const RowBit ROWS[12] = {
  {"12", 0, 0x01}, {"11", 0, 0x02}, {"0", 0, 0x04},
  {"1",  0, 0x08}, {"2",  0, 0x10}, {"3", 0, 0x40},
  {"4",  1, 0x01}, {"5",  1, 0x02}, {"6", 1, 0x04},
  {"7",  1, 0x08}, {"8",  1, 0x10}, {"9", 1, 0x40},
};

// Pack one column into a 12-bit mask in the physical order above:
// bit0 = row 12 (far edge) ... bit11 = row 9 (strobe edge).
static uint16_t packColumn(uint8_t b1, uint8_t b2) {
  const uint8_t pair[2] = { b1, b2 };
  uint16_t bits = 0;
  for (uint8_t i = 0; i < 12; i++) {
    if (pair[ROWS[i].byteIdx] & ROWS[i].mask) bits |= (uint16_t)1 << i;
  }
  return bits;
}

static void handleFrame(const uint8_t *buf, size_t n, bool truncated) {
  // A frame that overran frameBuf is NOT a card. Decoding it would produce a
  // structurally valid sheet with the tail missing — a wrong answer that looks
  // right, which is worse than a dropped one. Report it as raw+truncated and
  // never let it reach the decoder.
  if (truncated) {
    cTruncated++;
    recentPush("truncated", buf, n, true);
    emitRaw(buf, n, true);
    return;
  }

  // Command acknowledgements ("G", or an error echo ending in "?") share the
  // line with card data. They are never valid card records — drop them.
  if (n < 2) { cShortFrames++; return; }
  if (buf[n - 1] == '?') {
    cReaderErrors++;
    recentPush("reader-error", buf, n, false);
    JsonDocument doc;
    doc["source"] = "omr-relay";
    doc["type"]   = "reader-error";
    doc["id"]     = READER_ID;
    doc["echo"]   = toHex(buf, n);
    emit(doc);
    return;
  }
  if (n % 2) {          // a card record is always an even number of bytes
    recentPush("raw-odd", buf, n, false);
    emitRaw(buf, n);
    return;
  }
  cSheets++;
  recentPush("sheet", buf, n, false);
  logEvent("sheet", "decoded %u columns", (unsigned)(n / 2));
#if BUZZER_ENABLED
  buzzerPlay(SND_READ, SND_READ_LEN);   // "I read your sheet"
#endif
  // Sheets carry no natural key, so the ack matches oldest-outstanding-first.
  // Cards are fed one at a time by hand, so that is not a real ambiguity.
  ackExpect("sheet", "");

  JsonDocument doc;
  doc["source"]  = "omr-relay";
  doc["type"]    = "sheet";
  doc["id"]      = READER_ID;
  doc["columns"] = n / 2;

  JsonArray cols = doc["marks"].to<JsonArray>();
  uint16_t marked = 0;
  for (size_t i = 0; i + 1 < n; i += 2) {
    uint16_t bits = packColumn(buf[i], buf[i + 1]);
    cols.add(bits);
    if (bits) marked++;
  }
  doc["markedColumns"] = marked;
  emit(doc);
}

// --- plumbing ----------------------------------------------------------------

// Bounded, NON-blocking-forever. An earlier version spun in
// `while (WiFi.status() != WL_CONNECTED) delay(250);` with no exit — if the
// reader booted while the router was down (a power cut brings both back at once,
// and the ATOM wins that race), the relay sat red forever and never retried.
// Now: try for 20 s, then fall through and let loop() keep retrying. Matches the
// kitchen-relay pattern.
static const uint32_t WIFI_CONNECT_TIMEOUT_MS = 20000;
static const uint32_t WIFI_RETRY_PERIOD_MS    = 15000;

static void connectWifi() {
  WiFi.mode(WIFI_STA);
  WiFi.begin(WIFI_SSID, WIFI_PASSWORD);
  uint32_t t0 = millis();
  while (WiFi.status() != WL_CONNECTED && millis() - t0 < WIFI_CONNECT_TIMEOUT_MS) { delay(250); }
  if (WiFi.status() == WL_CONNECTED) {
    Serial.printf("[wifi] %s\n", WiFi.localIP().toString().c_str());
  } else {
    Serial.println("[wifi] FAILED (will retry)");
  }
}

void setup() {
  Serial.begin(115200);

#if NFC_ENABLED
  // M5Unified BEFORE FastLED. M5.begin() also touches the ATOM's onboard RGB on
  // GPIO27, so FastLED is initialised afterwards to take ownership of the pin
  // last. If the LED ever sits lit at rest, suspect this ordering first — the
  // resting state is dark, and that is the observable check.
  auto m5cfg = M5.config();
  M5.begin(m5cfg);
#endif

  FastLED.addLeds<SK6812, LED_PIN, GRB>(leds, NUM_LEDS);
  FastLED.setBrightness(40);
  // Force the LED dark at boot. setLed() short-circuits when the color is
  // unchanged and ledCurrent already starts Black, so it would never push the
  // first frame — leaving whatever the SK6812 powered up with lit.
  leds[0] = CRGB::Black;
  FastLED.show();

  // Belt-and-braces against a stalled loop(). Arduino's default RX ring is 256
  // bytes, which at 9600 baud is only ~267 ms of slack — thin once anything else
  // shares core 1 (the HTTP server already can). 2 KB buys ~2.1 s. Must be called
  // BEFORE begin() or it is ignored.
  OMR.setRxBufferSize(2048);
  OMR.begin(UART_BAUD, UART_CONFIG, UART_RX_PIN, UART_TX_PIN);

#if BUZZER_ENABLED
  buzzerInit();
#endif

  connectWifi();

  // onEvent BEFORE begin: begin() can dispatch immediately, and a handler
  // registered afterwards would miss that first transition — leaving wsConnected
  // false while the socket is actually up, so every emit() silently drops.
  ws.onEvent(onWsEvent);
  ws.setReconnectInterval(3000);
  ws.begin(BACKEND_HOST, BACKEND_PORT, WS_PATH);

  http.on("/",       handleStatus);
  http.on("/health", handleStatus);
  http.on("/queue",  handleQueue);
  http.on("/recent", handleRecent);
  http.on("/events", handleEvents);
  http.onNotFound([]() { http.send(404, "application/json", "{\"ok\":false,\"error\":\"not found\"}"); });
  http.begin();

#if NFC_ENABLED
  nfcQueue = xQueueCreate(NFC_HANDOFF_DEPTH, sizeof(NfcCard));
  if (!nfcQueue) {
    Serial.println("[nfc] xQueueCreate FAILED — NFC inactive");
  } else {
    // Core 0. loop() is on core 1, so a blocking detect() cannot delay the UART
    // drain. 8 KB stack: the M5 driver allocates std::vector per detect and this
    // is not a path where a stack overflow should be discovered in the field.
    xTaskCreatePinnedToCore(nfcTask, "nfc", 8192, nullptr, 1, nullptr, 0);
  }
#endif

  delay(200);
  downloadMode();
}

// Records are CR-terminated, so CR is the frame boundary. The idle timeout is
// only a backstop for a truncated record.
static const uint32_t FRAME_IDLE_MS   = 250;
static const uint32_t REARM_PERIOD_MS = 60000;  // re-download mode when idle
static const uint32_t REARM_QUIET_MS  = 5000;   // ...but never mid-scan

static uint8_t  frameBuf[512];
static size_t   frameLen       = 0;
static bool     frameTruncated = false;
static uint32_t lastByteMs     = 0;
static uint32_t lastArmMs      = 0;

static void flushFrame() {
  if (!frameLen) return;
  cFrames++;
  lastFrameMs = millis();
#if SNIFF_MODE
  recentPush(frameTruncated ? "truncated" : "sniff", frameBuf, frameLen, frameTruncated);
  emitRaw(frameBuf, frameLen, frameTruncated);
  if (frameTruncated) cTruncated++;
#else
  handleFrame(frameBuf, frameLen, frameTruncated);
#endif
  frameLen = 0;
  frameTruncated = false;
  // No state color here — the flash timer in loop() owns the LED and will take
  // it dark once the bytes stop.
}

static uint32_t lastWifiTryMs = 0;

void loop() {
  ws.loop();
  http.handleClient();
  drainQueue();

#if NFC_ENABLED
  // Before the UART read below, so a tap's ACK is as prompt as possible — but
  // still on core 1, which is what keeps emit() and the buzzer single-threaded.
  drainNfcQueue();
#endif
#if BUZZER_ENABLED
  buzzerService();
#endif
  // Fires the `failed` sound when the server never echoed. Unconditional: the
  // counters are worth keeping even on a board with no buzzer fitted.
  ackService();

  // WiFi watchdog. arduinoWebSockets reconnects its own socket, but it cannot
  // bring the radio back — if the AP drops, the station stays down until we
  // re-begin it.
  if (WiFi.status() != WL_CONNECTED && millis() - lastWifiTryMs > WIFI_RETRY_PERIOD_MS) {
    lastWifiTryMs = millis();
    WiFi.disconnect();
    WiFi.begin(WIFI_SSID, WIFI_PASSWORD);
  }

  while (OMR.available()) {
    int b = OMR.read();
    if (b < 0) break;
    lastByteMs = millis();
    cBytesRx++;
    // The ONLY thing that lights this LED: bytes arriving from the reader.
    setLed(FLASH_COLOR);
    ledOffAtMs = millis() + LED_FLASH_MS;
    // 0 is the "no flash pending" sentinel, so a deadline that lands exactly on
    // the millis() rollover would strand the LED lit until the next byte. Nudge
    // it by 1ms — the LED being stuck on is the one outcome this must not have.
    if (ledOffAtMs == 0) ledOffAtMs = 1;
    if (b == 0x0D) { flushFrame(); continue; }
    // Overrun is FLAGGED, not swallowed. The old code dropped the excess bytes
    // and then flushed the frame as if it were complete, so an over-long record
    // decoded into a plausible-looking short card. Now the frame is marked and
    // routed away from the decoder.
    if (frameLen < sizeof(frameBuf)) frameBuf[frameLen++] = (uint8_t)b;
    else frameTruncated = true;
  }

  if (frameLen > 0 && (millis() - lastByteMs) > FRAME_IDLE_MS) flushFrame();

  // Expire the data flash. Dark is the resting state — nothing else may light it.
  if (ledOffAtMs && (int32_t)(millis() - ledOffAtMs) >= 0) {
    ledOffAtMs = 0;
    setLed(CRGB::Black);
  }

  // Self-heal: if the reader is power-cycled it silently forgets its
  // conversion mode. Re-arming costs one "G" ack and is safe while idle.
  uint32_t now = millis();
  if (now - lastArmMs > REARM_PERIOD_MS && now - lastByteMs > REARM_QUIET_MS) {
    lastArmMs = now;
    downloadMode();
  }
}
